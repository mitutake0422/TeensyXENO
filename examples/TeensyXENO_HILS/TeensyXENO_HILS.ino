#include <TeensyXENO.h>

TeensyXENO g_clTX(TEENSY4_0);

IntervalTimer g_Timer50hz;
IntervalTimer g_Timer14ms;

void setup() {
	//----------------------------------------------
	// Timer
	//----------------------------------------------
	g_Timer50hz.begin(freq50hz, 20000);  // 20msec 50Hz
	g_Timer14ms.begin(freq14ms, 14000);  // 14msec SBUS
}

void loop() {

	//----------------------------------------------
	// SBUS
	//----------------------------------------------
	g_clTX.GetSBUS();
	
	//----------------------------------------------
	// XenoController
	//----------------------------------------------
	g_clTX.GetXenoController();
}

// SBUS
void freq14ms()
{
	//----------------------------------------------
	// SBUS
	//----------------------------------------------
	g_clTX.SendSBUS();
}

// 50Hz
void freq50hz()
{
	static int s_nCnt = 0;

	//----------------------------------------------
	// control
	//----------------------------------------------
	userfunc();

	//----------------------------------------------
	// PWM
	//----------------------------------------------
	g_clTX.SendPWM();

	//----------------------------------------------
	// XenoController
	//----------------------------------------------
	if (s_nCnt % 5 == 2) {
		g_clTX.SendXenoController();
	}

	//----------------------------------------------
	// HILS
	//----------------------------------------------
	// output
  if (s_nCnt % 5 == 0) {
    g_clTX.HILS_SendCtrl();
  }

	if (++s_nCnt == 50) {
		s_nCnt = 0;
	}
}